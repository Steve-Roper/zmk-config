/ {
    chosen {
        zmk,kscan = &kscan0;
    };

    kscan0: kscan0 {
        compatible = "zmk,kscan-gpio-matrix";
        diode-direction = "row2col";
        wakeup-source;

        row-gpios = <&gpio1 31 GPIO_ACTIVE_HIGH>,
                    <&gpio0 15 GPIO_ACTIVE_HIGH>,
                    <&gpio0 2  GPIO_ACTIVE_HIGH>,
                    <&gpio1 29 GPIO_ACTIVE_HIGH>,
                    <&gpio0 13 GPIO_ACTIVE_HIGH>;

        col-gpios = <&gpio0 20 (GPIO_ACTIVE_HIGH | GPIO_PULL_DOWN)>,
                    <&gpio0 22 (GPIO_ACTIVE_HIGH | GPIO_PULL_DOWN)>,
                    <&gpio0 24 (GPIO_ACTIVE_HIGH | GPIO_PULL_DOWN)>,
                    <&gpio1 0 (GPIO_ACTIVE_HIGH | GPIO_PULL_DOWN)>,
                    <&gpio0 11 (GPIO_ACTIVE_HIGH | GPIO_PULL_DOWN)>,
                    <&gpio0 17 (GPIO_ACTIVE_HIGH | GPIO_PULL_DOWN)>;
    };
};