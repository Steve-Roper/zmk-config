## boards/shields/keyve/Kconfig.defconfig
```kconfig
if SHIELD_KEYVE_LEFT

config ZMK_KEYBOARD_NAME
    default "keyve"

config ZMK_SPLIT_ROLE_CENTRAL
    default y

endif

if SHIELD_KEYVE_LEFT || SHIELD_KEYVE_RIGHT

config ZMK_SPLIT
    default y

endif
```
